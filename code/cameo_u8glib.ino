/*
 * Holmes <3 Watson Cameo Necklace
 * by brightcolorfulflickers
 * June 2016
 *
 * github.com/brightcolorfulflickers
 * brightcolorfulflickers.tumblr.com
 * instagram.com/brightcolorfulflickers
 */

#include "U8glib.h"

// Place your initialization settings here! Replace/delete whatever you need.

U8GLIB_SH1106_128X64 u8g(U8G_I2C_OPT_NONE);  // I2C / TWI 
//U8GLIB_SSD1306_128X64 u8g(U8G_I2C_OPT_NONE|U8G_I2C_OPT_DEV_0);  // I2C / TWI 
#define MOSI_PIN 9
#define CS_PIN 12
#define SCK_PIN 10
#define DC_PIN 9
//U8GLIB_SSD1306_128X64 u8g(SCK_PIN, MOSI_PIN, CS_PIN, DC_PIN);  // SW SPI Com: SCK = 13, MOSI = 11, CS = 10, A0 = 9

// End initialization section.

#define watsonheadtry3_width 68
#define watsonheadtry3_height 64
static const unsigned char watsonheadtry3_bits[] PROGMEM = {
   0x00, 0x00, 0x00, 0x00, 0x00, 0xf0, 0xff, 0xff, 0x0f, 0x00, 0x00, 0x00,
   0x00, 0x00, 0xf0, 0xff, 0xff, 0x0f, 0x00, 0x00, 0x00, 0x00, 0x00, 0xf8,
   0xff, 0xff, 0x0f, 0x00, 0x00, 0x00, 0x00, 0x00, 0xfc, 0xff, 0xff, 0x0f,
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   0x00, 0x00, 0x00, 0x00, 0x00, 0x00, 0x00, 0x00, 0x00, 0x00, 0x00, 0x00 };


#define holmes_width 79
#define holmes_height 64
static const unsigned char holmes_bits[] PROGMEM = {
   0x00, 0x00, 0x00, 0x00, 0x00, 0x00, 0xc0, 0x00, 0x00, 0x00, 0x00, 0x00,
   0x00, 0x00, 0x00, 0x00, 0xc0, 0x0f, 0x00, 0x00, 0x00, 0x00, 0x00, 0x00,
   0x00, 0x00, 0xc0, 0x3f, 0x00, 0x00, 0x00, 0x00, 0x00, 0x00, 0x00, 0x00,
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   0x00, 0x00, 0x02, 0x00 };


#define heart221b_width 64
#define heart221b_height 64
static const unsigned char heart221b_bits[] PROGMEM = {
   0x00, 0x00, 0x28, 0x00, 0x00, 0x00, 0x00, 0x00, 0x00, 0xc0, 0xff, 0x1f,
   0x00, 0x00, 0x00, 0x00, 0x00, 0xf0, 0xc3, 0x1d, 0x00, 0x00, 0x00, 0x00,
   0x00, 0x1c, 0xc3, 0xf0, 0x01, 0x00, 0x00, 0x00, 0x00, 0x0f, 0xc7, 0x30,
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   0x00, 0x00, 0x2c, 0x00, 0x00, 0x00, 0x00, 0x00 };
 

void drawNothing() {
  
}

void u8g_prepare(void) {
  u8g.setFont(u8g_font_6x10);
  u8g.setFontRefHeightExtendedText();
  u8g.setDefaultForegroundColor();
  u8g.setFontPosTop();
}

void drawSplash(void) {
  u8g_prepare();
  // graphic commands to redraw the complete screen should be placed here  
  //u8g.setFont(u8g_font_unifont);
  //u8g.setFont(u8g_font_osb21);
  u8g.drawStr( 40, 15, "Holmes <3");
  u8g.drawStr( 50, 25, "Watson");
  u8g.setFont(u8g_font_5x7);
  u8g.drawStr( 13, 42, "by pursuitofnerdiness");
}

void setup() {
  // put your setup code here, to run once:
  u8g.firstPage();
  do {  
    drawSplash();    
  } while( u8g.nextPage() );
  delay(2000); 
}

void drawHolmes(void) {
  // graphic commands to redraw the complete screen should be placed here  
  //u8g.drawBitmapP( 0, 0, 1, 8, rook_bitmap);
  u8g.drawXBMP( 30, 0, holmes_width, holmes_height, holmes_bits);
}

void drawHeart(void) {
  // graphic commands to redraw the complete screen should be placed here  
  //u8g.drawBitmapP( 0, 0, 1, 8, rook_bitmap);
  u8g.drawXBMP( 32, 0, heart221b_width, heart221b_height, heart221b_bits);
}

void drawWatson(void) {
  // graphic commands to redraw the complete screen should be placed here  
  //u8g.drawBitmapP( 0, 0, 1, 8, rook_bitmap);
  u8g.drawXBMP( 32, 0, watsonheadtry3_width, watsonheadtry3_height, watsonheadtry3_bits);
}


void loop(void) {
  // picture loop
  u8g.firstPage();  
  do {
    drawHolmes();
  } while( u8g.nextPage() );
  
  // rebuild the picture after some delay
  delay(5000);

  // picture loop
  u8g.firstPage();  
  do {
    drawHeart();
  } while( u8g.nextPage() );
  
  // rebuild the picture after some delay
  delay(5000);

 
  // picture loop
  u8g.firstPage();  
  do {
    drawWatson();
  } while( u8g.nextPage() );
  
  // rebuild the picture after some delay
  delay(5000);

    // picture loop
  u8g.firstPage();  
  do {
    drawHeart();
  } while( u8g.nextPage() );
  
  // rebuild the picture after some delay
  delay(5000);
}
